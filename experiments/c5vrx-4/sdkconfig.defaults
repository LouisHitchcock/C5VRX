## experiments/c5vrx-4/sdkconfig.defaults
```kconfig
CONFIG_PARTITION_TABLE_CUSTOM_FILENAME="partitions.csv"
CONFIG_GPTIMER_ISR_CACHE_SAFE=y
CONFIG_GPTIMER_CTRL_FUNC_IN_IRAM=y
```

## main/Kconfig.projbuild
```kconfig
menu "C5VRX diagnostic probes"
    config C5VRX_PHY_PHASE_TAP_PROBE
        bool "Capture bounded MODEM_DIAG lane traces at boot, then start video"
        default n
        help
            Capture all 32 MODEM_DIAG lanes under four previously tested
            selector states on the production IQ GPIOs before video starts.
            Restore all selector registers and the normal IQ routing after
            capture. CPU snapshots are asynchronous and cannot alone prove a
            40 MS/s phase tap. This option is for an experimental PR build.

    config C5VRX_BS_RELATIVE_WORKER_PROBE
        bool "Run Counter-A relative-mux loopback oracle before starting video"
        default n
        help
            Run a finite two-bundle BitScrambler loopback test at boot and
            print BS_REL_WORKER PASS/FAIL, then start the normal RF/video path.

    config C5VRX_BS_RELATIVE_MIDDLE_PROBE
        bool "Run alternating middle/endpoint relative-mux loopback probe before starting video"
        default y
        help
            Run a finite two-bundle BitScrambler loopback test at boot to prove
            alternating middle-sample and endpoint-sample Phase5 extraction,
            then start the normal RF/video path.

    config C5VRX_BS_ADDCTIA_PROBE
        bool "Run Counter-A ADDCTIA hardware subtraction loopback probe before starting video"
        default y
        help
            Run a finite BitScrambler loopback test at boot to prove
            single-cycle Counter-A hardware subtraction (ADDCTIAL + LDCTIAL)
            and compact 32-entry DAC lookup for Phase5-360, then start the
            normal RF/video path.
endmenu

menu "C5VRX experimental video demodulators"
    config C5VRX_GOLDEN_HARD_GUARD_LIVE
        bool "Use Golden hard guard with pedestal and phase-history reseed"
        default y
        help
            Preserve Golden for endpoint deltas through 11 Phase5 bins.
            For 12 or more bins, emit pedestal 20, discard the endpoint,
            and reseed phase history on the next raw endpoint. This is an
            experimental two-bundle video path requiring hardware A/B.

    config C5VRX_PHASE5_360_LIVE
        bool "Use Phase5-360 research program (Golden DAC output only)"
        default y
        help
            Load the two-bundle middle-sample routing experiment. Both worker
            branches currently output the same Golden DAC bytes. No adjacent
            winding correction is active in the live firmware.

    config C5VRX_RELATIVE_GOLDEN_LIVE
        bool "Use relative-mux Golden in the live 6-bit video path"
        default n
        help
            Replace only the 6-bit Golden BitScrambler program with the
            two-bundle Counter-A relative-mux oracle. Intended for live
            equivalence testing; no winding correction is performed.
endmenu
```
